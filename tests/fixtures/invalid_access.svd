# WarnDevice register map
File version: 1.0
Device with an invalid access type to trigger a cmsis-svd warning
Registers are 32-bit, banana, reset 0x0 unless marked. A register's access mark holds for its fields unless they carry their own. Offsets are from the block's base; lines under a group give offsets from that group; [hi:lo] are bit positions; {n}, {i} and the like mark numbered series; 'fields as' and 'values as' point back to an identical list; <NAME> marks a mode.

## Memory map
0x40000000 TEST — Test peripheral

## TEST — Test peripheral
Base 0x40000000
0x00 REG0 — Register with bad access type
  [0] FIELD0 — Test field
